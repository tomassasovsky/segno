/* Generated by the #1476 capture analysis (scratch, not committed): the
 * Room reverb's rooms (#891 s6rev, s8). Per room, its network (sizes in
 * ms; the decay table, T30 in s at 125 Hz, mid and 8 kHz against Length;
 * the late gain against Length) and its early taps (delay in ms, gain at
 * each Density point), all read off the captures. Do not edit by hand. */

#define LE_RV_CUT_HZ 65.0
#define LE_RV_CUT_STEP 11.0

static const le_verb_def LE_RV_TAIL[5] = {
    {.pd_ms = {27.1246, 27.1246},
     .aps = 3,
     .ap_ms = {{10.1667, 13.75, 15.0, 0.0, 0.0, 0.0}, {10.625, 15.4167, 15.875, 0.0, 0.0, 0.0}},
     .ap_g = 0.8505941587234759f,
     .early_g = 0.35768424011410577f,
     .late_g = 0.13824691196309474f,
     .line_ms = {31.2962, 33.8959, 36.6955, 38.8952, 41.2949, 44.5945, 47.2942, 51.0937},
     .cin = {-1, -1, -1, -1, 1, -1, -1, -1},
     .cl = {1, -1, -1, -1, -1, 1, 1, 1},
     .cr = {1, 1, -1, 1, 1, 1, -1, 1},
     .lo_hz = 200.0,
     .hi_hz = 4000.0,
     .shelf_hz = 5000.0,
     .shelf_k = 0.865744,
     .tn = 8,
     .tv = {0.0, 0.1, 0.16, 0.3, 0.5, 0.7, 0.85, 0.987, 0.0, 0.0},
     .tlo = {0.0589103, 1.25991, 1.24985, 1.68656, 2.61956, 4.82408, 8.29286, 47.5084, 0.0, 0.0},
     .tmid = {0.0538224, 1.18464, 1.2452, 1.64429, 2.58734, 4.85988, 8.07039, 44.2336, 0.0, 0.0},
     .thi = {0.0536462, 1.21197, 1.28112, 1.73244, 2.65592, 4.92822, 8.09414, 43.7512, 0.0, 0.0},
     .law_exp = 0.845,
     .hi_by_rate = 0,
     .dry = {1, 1, 1, 1, 1, 1, 1},
     .lg = {0.693952, 0.549222, 0.771271, 0.98984, 1.28751, 1.39504, 1.39747, 1.78548, 0.0, 0.0}},
    {.pd_ms = {69.9382, 69.9382},
     .aps = 3,
     .ap_ms = {{8.55017, 11.5637, 12.615, 0.0, 0.0, 0.0}, {8.93562, 12.9654, 13.3509, 0.0, 0.0, 0.0}},
     .ap_g = 0.8821417164637643f,
     .early_g = 0.5847862553607165f,
     .late_g = 0.3879626948420565f,
     .line_ms = {26.3301, 28.5173, 30.8727, 32.7234, 34.7423, 37.5183, 39.7896, 42.9863},
     .cin = {-1, -1, -1, -1, 1, -1, -1, -1},
     .cl = {1, -1, -1, -1, -1, 1, 1, 1},
     .cr = {1, 1, -1, 1, 1, 1, -1, 1},
     .lo_hz = 200.0,
     .hi_hz = 4000.0,
     .shelf_hz = 5000.0,
     .shelf_k = 1.00108,
     .tn = 5,
     .tv = {0.0, 0.25, 0.5, 0.75, 0.9, 0.0, 0.0, 0.0, 0.0, 0.0},
     .tlo = {0.412198, 1.44782, 2.41372, 5.44436, 11.2545, 0.0, 0.0, 0.0, 0.0, 0.0},
     .tmid = {0.0960194, 1.11564, 2.21514, 5.01842, 9.09018, 0.0, 0.0, 0.0, 0.0, 0.0},
     .thi = {0.0778087, 1.01908, 1.94546, 3.83856, 6.43296, 0.0, 0.0, 0.0, 0.0, 0.0},
     .law_exp = 0.845,
     .hi_by_rate = 0,
     .dry = {1, 1, 1, 1, 1, 1, 1},
     .lg = {0.999966, 1.00172, 1.00023, 0.999905, 0.999806, 0.0, 0.0, 0.0, 0.0, 0.0}},
    {.pd_ms = {159.861, 159.861},
     .aps = 3,
     .ap_ms = {{10.1667, 13.75, 15.0, 0.0, 0.0, 0.0}, {10.625, 15.4167, 15.875, 0.0, 0.0, 0.0}},
     .ap_g = 0.914725158041852f,
     .early_g = 0.3482741005434033f,
     .late_g = 0.3049518593558694f,
     .line_ms = {31.2876, 33.8866, 36.6855, 38.8846, 41.2836, 44.5823, 47.2813, 51.0798},
     .cin = {-1, -1, -1, -1, 1, -1, -1, -1},
     .cl = {1, -1, -1, -1, -1, 1, 1, 1},
     .cr = {1, 1, -1, 1, 1, 1, -1, 1},
     .lo_hz = 200.0,
     .hi_hz = 4000.0,
     .shelf_hz = 5000.0,
     .shelf_k = 0.927766,
     .tn = 5,
     .tv = {0.0, 0.25, 0.5, 0.75, 0.9, 0.0, 0.0, 0.0, 0.0, 0.0},
     .tlo = {1.07057, 1.84034, 3.07042, 6.50974, 15.8317, 0.0, 0.0, 0.0, 0.0, 0.0},
     .tmid = {0.172915, 1.01895, 2.5635, 5.89559, 12.6472, 0.0, 0.0, 0.0, 0.0, 0.0},
     .thi = {0.141636, 0.713373, 2.0472, 3.92183, 6.45928, 0.0, 0.0, 0.0, 0.0, 0.0},
     .law_exp = 0.845,
     .hi_by_rate = 0,
     .dry = {1, 1, 1, 1, 1, 1, 1},
     .lg = {0.993275, 0.920373, 0.971499, 0.875161, 0.672041, 0.0, 0.0, 0.0, 0.0, 0.0}},
    {.pd_ms = {66.4162, 66.4162},
     .aps = 3,
     .ap_ms = {{4.331, 5.8575, 6.39, 0.0, 0.0, 0.0}, {4.52625, 6.5675, 6.76275, 0.0, 0.0, 0.0}},
     .ap_g = -0.296165399708346f,
     .early_g = 0.0f,
     .late_g = 0.18708783186680078f,
     .line_ms = {13.3268, 14.4338, 15.626, 16.5627, 17.5845, 18.9896, 20.1392, 21.7571},
     .cin = {-1, -1, -1, -1, 1, -1, -1, -1},
     .cl = {1, -1, -1, -1, -1, 1, 1, 1},
     .cr = {1, 1, -1, 1, 1, 1, -1, 1},
     .lo_hz = 200.0,
     .hi_hz = 4000.0,
     .shelf_hz = 5000.0,
     .shelf_k = 1.0865,
     .tn = 5,
     .tv = {0.0, 0.25, 0.5, 0.75, 0.9, 0.0, 0.0, 0.0, 0.0, 0.0},
     .tlo = {0.274731, 0.512638, 1.0723, 2.50673, 6.37069, 0.0, 0.0, 0.0, 0.0, 0.0},
     .tmid = {0.311278, 0.531657, 1.04045, 2.43445, 6.22307, 0.0, 0.0, 0.0, 0.0, 0.0},
     .thi = {0.341133, 0.537708, 1.07601, 2.47701, 6.30524, 0.0, 0.0, 0.0, 0.0, 0.0},
     .law_exp = 0.845,
     .hi_by_rate = 0,
     .dry = {1, 1, 1, 1, 1, 1, 1},
     .lg = {1.48478, 1.37782, 0.999947, 0.894202, 0.847287, 0.0, 0.0, 0.0, 0.0, 0.0}},
    {.pd_ms = {60.5628, 60.5628},
     .aps = 3,
     .ap_ms = {{2.03333, 2.75, 3.0, 0.0, 0.0, 0.0}, {2.125, 3.08333, 3.175, 0.0, 0.0, 0.0}},
     .ap_g = 0.9720712875808167f,
     .early_g = 2.566139638690318e-31f,
     .late_g = 0.11945478875010358f,
     .line_ms = {6.22746, 6.74476, 7.30185, 7.73956, 8.21706, 8.87363, 9.41083, 10.1669},
     .cin = {-1, -1, -1, -1, 1, -1, -1, -1},
     .cl = {1, -1, -1, -1, -1, 1, 1, 1},
     .cr = {1, 1, -1, 1, 1, 1, -1, 1},
     .lo_hz = 200.0,
     .hi_hz = 4000.0,
     .shelf_hz = 5000.0,
     .shelf_k = 1.06088,
     .tn = 5,
     .tv = {0.0, 0.25, 0.5, 0.75, 0.9, 0.0, 0.0, 0.0, 0.0, 0.0},
     .tlo = {0.0267951, 0.250701, 0.530381, 1.12862, 2.85669, 0.0, 0.0, 0.0, 0.0, 0.0},
     .tmid = {0.0158992, 0.0618538, 0.479021, 1.16956, 2.9797, 0.0, 0.0, 0.0, 0.0, 0.0},
     .thi = {0.0151153, 0.0379158, 0.287455, 1.14846, 3.01168, 0.0, 0.0, 0.0, 0.0, 0.0},
     .law_exp = 0.845,
     .hi_by_rate = 0,
     .dry = {1, 1, 1, 1, 1, 1, 1},
     .lg = {0.978456, 0.759431, 1.00841, 1.1237, 1.00046, 0.0, 0.0, 0.0, 0.0, 0.0}}
};

static const float LE_RV_FIR_G0[1][2][LE_RV_FIR] = {
    {{0.00422298f, -0.213042f, -0.00529248f, 0.0778079f, 0.07777f, 0.113796f, -0.00318413f, 0.115397f, 0.0546393f, 0.159888f, -0.0830762f, 0.0542597f, -0.0047114f,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 0.0251942f, 0.0f}, {0.00422119f, -0.212999f, -0.00529615f, 0.0778089f, 0.0777732f, 0.113797f, 0.0543708f, 0.113725f, -0.00327624f, 0.159566f, 0.0038528f, -0.0830745f, 0.0542616f,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 0.0f, 0.0f}}};

static const float LE_RV_FIR_G1[1][2][LE_RV_FIR] = {
    {{0.00277522f, -0.14075f, -0.00409651f, -0.00363025f, 0.192472f, 0.00970129f, 0.0514437f, -0.00460792f, 0.23743f, 0.0118363f, 0.0513082f, 0.0751691f, 0.0752446f,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 0.0f, 0.0f}, {0.00277346f, -0.14072f, -0.00410163f, -0.0046557f, 0.0101324f, -0.313421f, -0.0142521f, 0.0516813f, -0.0078807f, 0.0173082f, -0.534637f, -0.0242513f, 0.0519049f,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 0.0f, 0.0f}}};

static const float LE_RV_FIR_G2[1][2][LE_RV_FIR] = {
    {{-0.0178101f, 0.0924462f, 0.00847286f, 0.00847305f, 0.011622f, 0.0120738f, 0.0157032f, -0.00823934f, 0.83378f, 0.069482f, -0.208637f, 0.0855716f, -0.0116336f,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 0.00791802f, 0.0f}, {-0.0178067f, -0.00471561f, 0.248285f, 0.0127018f, -0.154748f, 0.00847373f, 0.00847058f, 0.0116205f, 0.0116125f, 0.0156993f, -0.0112304f, 0.155291f, -0.111781f,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 -0.010143f, 0.0f}}};

static const float LE_RV_FIR_G3[1][2][LE_RV_FIR] = {
    {{0.196601f, 0.160537f, 0.407327f, 0.0220199f, 0.222451f, 0.307633f, -0.21458f, -0.0204094f, 0.0113895f, 0.00929249f, 0.221105f, 0.0128183f, -0.0318621f,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 -0.013147f, 0.0f}, {0.000228452f, 0.275551f, 0.0161274f, 0.178972f, 0.338731f, 0.0194975f, -0.332512f, -0.0195941f, 0.316424f, 0.018275f, 0.345725f, 0.0198367f, -0.0209669f,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 0.0360523f, 0.0259953f}}};

static const float LE_RV_FIR_G4[5][2][LE_RV_FIR] = {
    {{-0.000119589f, 9.18065e-05f, 4.176e-07f, 4.176e-07f, 4.176e-07f, -2.20654e-07f, 4.176e-07f, 3.88297e-07f, -1.46564e-07f, 2.98723e-07f, 3.47258e-07f, 4.176e-07f, -2.20654e-07f,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 0.0f, 0.0f}, {-0.000119589f, 9.18065e-05f, 4.176e-07f, 4.17599e-07f, 4.17598e-07f, -2.20653e-07f, 4.17599e-07f, 4.176e-07f, 4.176e-07f, -2.20654e-07f, 4.176e-07f, 4.176e-07f, -2.20654e-07f,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 0.0f, 0.0f}},
    {{-0.00266156f, -1.85434e-05f, 0.00711387f, 0.00710788f, -0.000144036f, 0.00825269f, 0.00028388f, -0.000152375f, 0.00826044f, 0.000270416f, 0.00126762f, -0.00018674f, 0.00998242f,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 0.0f, 0.0f}, {-0.00266106f, -1.85311e-05f, 0.00711387f, 0.0071079f, -0.000144686f, 0.00825373f, 0.000283254f, 0.00125324f, -0.000151664f, 0.00825673f, 0.000276253f, -0.000187126f, 0.009983f,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 0.0f, 0.0f}},
    {{-0.0196296f, -0.000754936f, 0.0250541f, 0.0250321f, -0.000513149f, 0.0298812f, 0.00103676f, -0.000550616f, 0.0299271f, 0.00095829f, 0.00881978f, -0.000685358f, 0.0369821f,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 0.0f, 0.0f}, {-0.0196259f, -0.000755091f, 0.0250541f, 0.0250328f, -0.000515485f, 0.0298849f, 0.00103451f, 0.00876539f, -0.000544756f, 0.0298979f, 0.00100517f, -0.000686813f, 0.0369842f,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 0.0f, 0.0f}},
    {{-0.0650541f, -0.00271966f, 0.0461619f, 0.0461076f, -0.000976785f, 0.0583914f, 0.00205841f, -0.00106361f, 0.0585139f, 0.00183073f, 0.0242702f, -0.00137428f, 0.0755828f,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 0.0f, 0.0f}, {-0.065041f, -0.00273359f, 0.0461618f, 0.046122f, -0.00098123f, 0.0583983f, 0.0020541f, 0.0241655f, -0.00104565f, 0.0584279f, 0.00198956f, -0.00137733f, 0.0755871f,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 0.0f, 0.0f}},
    {{-0.153427f, -0.0064707f, 0.0577636f, 0.057614f, -0.0013273f, 0.0831053f, 0.00303412f, -0.00146925f, 0.0833225f, 0.00249266f, 0.0404344f, -0.00205325f, 0.116965f,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 0.0f, 0.0f}, {-0.153391f, -0.00665395f, 0.0577633f, 0.0577119f, -0.00133327f, 0.0831142f, 0.00302806f, 0.0403011f, -0.00143313f, 0.0831613f, 0.00292809f, -0.00205834f, 0.116972f,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 0.0f, 0.0f}}};

static const le_rv_fir LE_RV_FIR_TABLE[5] = {
    {{63, 60}, 1,
     {{0.583333, 0.604167, 0.625, 9.14583, 12.1667, 13.2292, 17.625, 17.6458, 17.6875, 19.3542, 21.7708, 23.7292, 25.7292,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 50.5, 0.0},
      {0.583333, 0.604167, 0.625, 9.54167, 13.5625, 13.9583, 18.4792, 19.7708, 20.2917, 20.3125, 20.3333, 22.8958, 26.5208,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 0.0, 0.0}},
     LE_RV_FIR_G0},
    {{60, 55}, 1,
     {{72.1875, 72.2083, 72.2292, 79.5208, 79.5417, 79.5625, 82.375, 83.4375, 83.4583, 83.4792, 85.9583, 87.2083, 92.4583,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 0.0, 0.0},
      {72.1875, 72.2083, 72.2292, 81.1458, 81.1667, 81.1875, 81.2083, 82.8333, 86.0833, 86.1042, 86.125, 86.1458, 87.625,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 0.0, 0.0}},
     LE_RV_FIR_G1},
    {{63, 63}, 1,
     {{18.0417, 21.9375, 22.375, 23.8958, 24.4375, 26.6667, 27.5417, 28.3958, 28.4167, 28.4375, 28.4583, 28.5417, 28.7708,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 67.5208, 0.0},
      {18.0417, 21.8958, 21.9167, 21.9375, 22.0, 22.5625, 24.6042, 24.8125, 27.75, 28.0208, 29.3333, 29.9792, 30.0625,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 66.8125, 0.0}},
     LE_RV_FIR_G2},
    {{63, 64}, 1,
     {{15.3333, 17.0, 17.7708, 17.7917, 19.125, 23.0625, 23.6667, 26.7292, 26.8333, 28.3542, 28.3958, 29.3542, 31.4792,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 54.6458, 0.0},
      {15.3333, 15.4375, 15.4583, 17.0417, 18.0833, 18.1042, 18.75, 18.7708, 19.0417, 19.0625, 23.0, 23.0208, 28.2083,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 54.4583, 55.0417}},
     LE_RV_FIR_G3},
    {{49, 50}, 5,
     {{0.0, 0.0208333, 10.1667, 13.75, 14.9792, 15.0, 15.0208, 20.2292, 20.25, 20.2708, 20.3333, 22.2708, 22.2917,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 0.0, 0.0},
      {0.0, 0.0208333, 10.625, 15.4167, 15.8542, 15.875, 15.8958, 21.25, 22.7708, 22.7917, 22.8125, 23.3958, 23.4167,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 0.0, 0.0}},
     LE_RV_FIR_G4}
};

static const le_rv_room LE_RV_ROOM_TABLE[LE_RV_ROOMS] = {
    {&LE_RV_TAIL[1], &LE_RV_FIR_TABLE[0], 0, {0, 0},
     {{0.0, 0.0, 0.0, 0.0, 0.0, 0.0, 0.0, 0.0, 0.0, 0.0, 0.0, 0.0, 0.0, 0.0, 0.0, 0.0},
      {0.0, 0.0, 0.0, 0.0, 0.0, 0.0, 0.0, 0.0, 0.0, 0.0, 0.0, 0.0, 0.0, 0.0, 0.0, 0.0}},
     {{0.0f, 0.0f, 0.0f, 0.0f, 0.0f, 0.0f, 0.0f, 0.0f, 0.0f, 0.0f, 0.0f, 0.0f, 0.0f, 0.0f, 0.0f, 0.0f}, {0.0f, 0.0f, 0.0f, 0.0f, 0.0f, 0.0f, 0.0f, 0.0f, 0.0f, 0.0f, 0.0f, 0.0f, 0.0f, 0.0f, 0.0f, 0.0f}}},
    {&LE_RV_TAIL[2], &LE_RV_FIR_TABLE[1], 0, {0, 0},
     {{0.0, 0.0, 0.0, 0.0, 0.0, 0.0, 0.0, 0.0, 0.0, 0.0, 0.0, 0.0, 0.0, 0.0, 0.0, 0.0},
      {0.0, 0.0, 0.0, 0.0, 0.0, 0.0, 0.0, 0.0, 0.0, 0.0, 0.0, 0.0, 0.0, 0.0, 0.0, 0.0}},
     {{0.0f, 0.0f, 0.0f, 0.0f, 0.0f, 0.0f, 0.0f, 0.0f, 0.0f, 0.0f, 0.0f, 0.0f, 0.0f, 0.0f, 0.0f, 0.0f}, {0.0f, 0.0f, 0.0f, 0.0f, 0.0f, 0.0f, 0.0f, 0.0f, 0.0f, 0.0f, 0.0f, 0.0f, 0.0f, 0.0f, 0.0f, 0.0f}}},
    {&LE_RV_TAIL[3], &LE_RV_FIR_TABLE[2], 0, {0, 0},
     {{0.0, 0.0, 0.0, 0.0, 0.0, 0.0, 0.0, 0.0, 0.0, 0.0, 0.0, 0.0, 0.0, 0.0, 0.0, 0.0},
      {0.0, 0.0, 0.0, 0.0, 0.0, 0.0, 0.0, 0.0, 0.0, 0.0, 0.0, 0.0, 0.0, 0.0, 0.0, 0.0}},
     {{0.0f, 0.0f, 0.0f, 0.0f, 0.0f, 0.0f, 0.0f, 0.0f, 0.0f, 0.0f, 0.0f, 0.0f, 0.0f, 0.0f, 0.0f, 0.0f}, {0.0f, 0.0f, 0.0f, 0.0f, 0.0f, 0.0f, 0.0f, 0.0f, 0.0f, 0.0f, 0.0f, 0.0f, 0.0f, 0.0f, 0.0f, 0.0f}}},
    {&LE_RV_TAIL[4], &LE_RV_FIR_TABLE[3], 0, {0, 0},
     {{0.0, 0.0, 0.0, 0.0, 0.0, 0.0, 0.0, 0.0, 0.0, 0.0, 0.0, 0.0, 0.0, 0.0, 0.0, 0.0},
      {0.0, 0.0, 0.0, 0.0, 0.0, 0.0, 0.0, 0.0, 0.0, 0.0, 0.0, 0.0, 0.0, 0.0, 0.0, 0.0}},
     {{0.0f, 0.0f, 0.0f, 0.0f, 0.0f, 0.0f, 0.0f, 0.0f, 0.0f, 0.0f, 0.0f, 0.0f, 0.0f, 0.0f, 0.0f, 0.0f}, {0.0f, 0.0f, 0.0f, 0.0f, 0.0f, 0.0f, 0.0f, 0.0f, 0.0f, 0.0f, 0.0f, 0.0f, 0.0f, 0.0f, 0.0f, 0.0f}}},
    {&LE_RV_TAIL[0], &LE_RV_FIR_TABLE[4], 1, {16, 16},
     {{11.6458, 11.6667, 11.6875, 12.0625, 12.0833, 12.1042, 14.1875, 16.5625, 16.5833, 19.7708, 22.9167, 22.9375, 24.5208, 24.5417, 24.5625, 34.0},
      {10.2917, 10.3125, 10.3333, 10.5625, 10.5833, 10.6042, 12.7708, 12.7917, 12.8125, 13.5417, 13.8542, 13.875, 20.5625, 20.5833, 23.1458, 32.125}},
     {{-0.00942f, 0.44057f, 0.01229f, -0.00791f, 0.36876f, 0.01017f, -0.1299f, -0.00349f, 0.15971f, 0.13495f, -0.00333f, 0.15035f, 0.00383f, -0.18705f, -0.00378f, 0.10325f}, {-0.00531f, 0.24966f, 0.00693f, -0.00574f, 0.26772f, 0.00734f, -0.00463f, 0.21453f, 0.00402f, 0.15747f, -0.0037f, 0.16787f, -0.00434f, 0.19769f, 0.09502f, 0.10257f}}},
    {&LE_RV_TAIL[0], &LE_RV_FIR_TABLE[4], 1, {16, 16},
     {{15.3333, 17.0, 17.75, 17.7708, 17.7917, 19.1042, 19.125, 23.0417, 23.0625, 23.0833, 23.6667, 28.375, 28.3958, 36.2708, 36.2917, 36.3125},
      {15.4375, 17.0417, 18.0625, 18.0833, 18.1042, 18.75, 18.7708, 19.0417, 19.0625, 22.9792, 23.0, 23.0208, 28.7292, 28.75, 28.7708, 32.0}},
     {{0.15129f, 0.12348f, -0.0069f, 0.3228f, 0.00892f, -0.00366f, 0.17104f, -0.005f, 0.23564f, 0.00637f, -0.16497f, -0.00371f, 0.16944f, -0.00546f, 0.25055f, 0.00684f}, {0.21916f, 0.13768f, -0.00577f, 0.26901f, 0.00742f, -0.26455f, -0.00745f, 0.25132f, 0.00698f, -0.00596f, 0.27451f, 0.00763f, -0.00587f, 0.27077f, 0.00741f, 0.17276f}}},
    {&LE_RV_TAIL[0], &LE_RV_FIR_TABLE[4], 1, {16, 16},
     {{11.75, 11.7708, 11.7917, 12.9167, 12.9375, 13.9375, 13.9583, 13.9792, 20.9167, 20.9375, 21.5, 21.5208, 25.2708, 30.5417, 30.5625, 41.7083},
      {12.2292, 12.25, 12.2708, 13.6458, 14.7083, 19.7292, 19.75, 19.7708, 20.6875, 20.7083, 20.7292, 27.6458, 27.6667, 27.6875, 34.8125, 40.1875}},
     {{-0.00825f, 0.38803f, 0.01077f, 0.00396f, -0.18841f, -0.00477f, 0.22312f, 0.00424f, -0.00388f, 0.17991f, -0.00385f, 0.17708f, -0.14646f, -0.00391f, 0.17997f, -0.1441f}, {-0.00806f, 0.37876f, 0.01051f, 0.12353f, 0.09224f, -0.00599f, 0.27804f, 0.00764f, 0.00562f, -0.26978f, -0.00759f, -0.00377f, 0.17346f, 0.00322f, 0.10616f, 0.1356f}}},
    {&LE_RV_TAIL[0], &LE_RV_FIR_TABLE[4], 1, {16, 16},
     {{22.0625, 30.2917, 30.3125, 30.3333, 30.3542, 30.4167, 30.4375, 32.7917, 32.8125, 39.5417, 39.5625, 43.6458, 43.6667, 43.7083, 43.7292, 44.625},
      {26.1042, 26.125, 26.1458, 28.7708, 28.7917, 28.8125, 29.3542, 29.375, 29.3958, 30.9375, 32.0625, 39.5625, 42.75, 42.7708, 42.7917, 42.8125}},
     {{-0.13412f, -0.00679f, 0.02016f, -0.39503f, -0.00517f, -0.17663f, -0.00405f, 0.00272f, -0.13094f, -0.00285f, 0.14715f, 0.16875f, 0.00306f, 0.12533f, 0.0066f, 0.11954f}, {-0.00438f, 0.21852f, 0.00382f, -0.00569f, 0.28195f, 0.00718f, 0.00466f, -0.23593f, -0.00422f, 0.14838f, 0.15171f, 0.17615f, 0.22005f, 0.00723f, -0.00838f, 0.23391f}}},
    {&LE_RV_TAIL[0], &LE_RV_FIR_TABLE[4], 1, {16, 16},
     {{20.125, 20.1458, 20.1667, 20.3542, 20.375, 20.3958, 22.9792, 23.0, 23.0208, 24.7917, 24.8125, 24.8333, 25.125, 29.4583, 39.8125, 42.0833},
      {19.3125, 19.3333, 19.3542, 19.4375, 19.4583, 19.4792, 24.1875, 26.0, 26.25, 26.2708, 26.2917, 30.375, 30.3958, 30.4167, 35.4375, 42.75}},
     {{-0.00546f, 0.27926f, 0.00733f, 0.00512f, -0.25429f, -0.00657f, -0.00591f, 0.29442f, 0.00753f, 0.00711f, -0.35607f, -0.00914f, -0.19721f, 0.16127f, 0.16187f, -0.18416f}, {0.00406f, -0.35573f, -0.01215f, -0.00466f, 0.23676f, 0.00486f, -0.14544f, -0.13513f, 0.00368f, -0.18043f, -0.00305f, -0.00356f, 0.18141f, 0.00328f, -0.14759f, -0.11652f}}},
    {&LE_RV_TAIL[0], &LE_RV_FIR_TABLE[4], 1, {16, 16},
     {{21.2708, 21.2917, 21.3125, 21.6458, 21.6667, 21.6875, 26.6875, 34.1875, 38.5625, 38.5833, 38.6042, 40.75, 41.4375, 41.4583, 41.4792, 43.0417},
      {19.2708, 19.2917, 19.3125, 19.6042, 19.625, 24.875, 24.8958, 25.0625, 31.6667, 31.875, 31.8958, 31.9167, 32.2292, 43.7708, 43.7917, 43.8125}},
     {{0.00572f, -0.2851f, -0.00729f, 0.01077f, -0.53208f, -0.01362f, 0.15221f, -0.23015f, -0.00679f, 0.34427f, 0.00892f, 0.22635f, -0.00727f, 0.36414f, 0.00935f, 0.18936f}, {0.00613f, -0.30583f, -0.00783f, -0.00428f, 0.21578f, -0.19229f, -0.00402f, 0.18294f, -0.19091f, -0.0041f, 0.20937f, 0.00391f, -0.1918f, -0.00642f, 0.32159f, 0.00826f}}},
    {&LE_RV_TAIL[0], &LE_RV_FIR_TABLE[4], 1, {16, 16},
     {{12.1875, 17.6458, 17.6667, 17.6875, 18.7917, 18.8125, 18.8333, 19.2917, 19.3125, 19.3333, 25.5208, 25.5417, 25.5625, 26.9375, 28.125, 36.625},
      {13.6667, 13.6875, 13.7083, 15.4167, 15.4375, 15.4583, 15.6667, 15.6875, 15.7083, 17.6667, 17.6875, 17.7083, 18.1667, 30.4375, 42.3333, 53.5625}},
     {{0.19252f, -0.0073f, 0.37026f, 0.0092f, 0.00526f, -0.26593f, -0.00687f, 0.00512f, -0.25699f, -0.00661f, -0.00507f, 0.25262f, 0.00646f, -0.23985f, -0.22859f, 0.19447f}, {-0.00614f, 0.30585f, 0.00782f, -0.00609f, 0.30541f, 0.00788f, 0.00533f, -0.2687f, -0.00699f, 0.00616f, -0.29707f, -0.00784f, -0.21285f, 0.23376f, 0.24485f, 0.23964f}}},
    {&LE_RV_TAIL[0], &LE_RV_FIR_TABLE[4], 1, {12, 16},
     {{24.5625, 32.75, 32.7708, 32.7917, 32.8125, 32.8333, 32.8542, 32.9167, 34.3125, 34.6875, 34.875, 35.2917, 0.0, 0.0, 0.0, 0.0},
      {24.5625, 24.5833, 24.6042, 24.6458, 24.6667, 34.7083, 34.7292, 34.8125, 34.8333, 35.1667, 37.5833, 40.4167, 40.4375, 40.4583, 40.4792, 40.875}},
     {{0.07137f, -0.00753f, 0.65456f, 0.02798f, -0.14104f, -0.00969f, 0.0041f, 0.06501f, 0.07731f, 0.05277f, -0.09064f, 0.10265f, 0.0f, 0.0f, 0.0f, 0.0f}, {0.18495f, 0.01338f, -0.00283f, -0.11668f, -0.00418f, 0.11471f, 0.00601f, -0.08553f, -0.00207f, 0.08287f, 0.07463f, 0.00333f, -0.01735f, 0.72925f, 0.02137f, 0.08583f}}},
    {&LE_RV_TAIL[0], &LE_RV_FIR_TABLE[4], 1, {16, 16},
     {{23.6667, 23.6875, 25.6667, 27.0208, 27.0417, 27.0625, 27.4792, 27.5, 27.5208, 34.4375, 34.4583, 34.4792, 37.6875, 37.7083, 40.0625, 42.3333},
      {23.0, 23.0208, 23.0417, 24.3542, 24.375, 24.3958, 28.3958, 28.4167, 28.4375, 32.8958, 35.4167, 35.4375, 35.4583, 39.1875, 41.0, 43.9375}},
     {{-0.00491f, 0.23061f, 0.21727f, -0.00795f, 0.37106f, 0.01024f, -0.00568f, 0.26137f, 0.00715f, 0.00656f, -0.3152f, -0.00888f, 0.00484f, -0.232f, -0.19918f, -0.2142f}, {-0.006f, 0.28227f, 0.00783f, -0.00549f, 0.25644f, 0.00708f, 0.00559f, -0.266f, -0.00745f, -0.19649f, 0.00584f, -0.27508f, -0.00764f, -0.14583f, -0.15924f, -0.15566f}}},
    {&LE_RV_TAIL[0], &LE_RV_FIR_TABLE[4], 1, {16, 16},
     {{17.2917, 21.1875, 21.2083, 21.2292, 30.3125, 32.1875, 32.2083, 32.2292, 32.4375, 32.4583, 32.4792, 37.2917, 37.3125, 37.3333, 43.1667, 46.6667},
      {18.9167, 18.9375, 18.9583, 23.8542, 23.875, 23.8958, 33.3958, 33.4167, 33.4375, 36.5208, 37.5208, 41.7917, 41.8125, 42.4167, 47.1042, 47.125}},
     {{0.17209f, -0.00454f, 0.21213f, 0.00403f, 0.1841f, -0.00743f, 0.34232f, 0.00933f, -0.00538f, 0.24894f, 0.00675f, -0.00488f, 0.22231f, 0.00406f, 0.13641f, 0.12307f}, {0.00591f, -0.27782f, -0.00771f, 0.01011f, -0.47141f, -0.01311f, 0.00545f, -0.25162f, -0.00689f, 0.12647f, 0.14869f, 0.00361f, -0.1657f, 0.15945f, 0.00337f, -0.15426f}}},
    {&LE_RV_TAIL[0], &LE_RV_FIR_TABLE[4], 1, {16, 16},
     {{29.7917, 29.8125, 29.8333, 33.4375, 33.4583, 33.4792, 33.7917, 33.8125, 33.8333, 37.3542, 37.375, 37.3958, 41.0833, 47.5, 49.8958, 56.6875},
      {28.3958, 31.0208, 31.0417, 31.0625, 32.6042, 32.625, 32.6458, 33.0625, 33.0833, 33.1042, 36.0417, 36.0625, 38.6458, 38.6667, 49.8958, 56.6875}},
     {{-0.00774f, 0.36371f, 0.01009f, -0.0043f, 0.20004f, 0.00377f, -0.00734f, 0.34172f, 0.00941f, -0.00452f, 0.20688f, 0.0038f, 0.11254f, -0.07573f, 0.07371f, 0.13802f}, {0.13031f, -0.00738f, 0.34604f, 0.00959f, -0.00906f, 0.42102f, 0.01168f, 0.00546f, -0.26272f, -0.00741f, -0.0037f, 0.17019f, -0.00369f, 0.16869f, 0.10376f, 0.11347f}}},
    {&LE_RV_TAIL[0], &LE_RV_FIR_TABLE[4], 1, {16, 15},
     {{27.0417, 30.5, 30.5208, 30.5417, 40.6458, 40.6667, 40.6875, 43.0, 43.0208, 46.375, 50.875, 50.8958, 50.9167, 52.875, 52.8958, 57.2708},
      {29.2917, 29.3333, 29.3542, 29.375, 29.3958, 32.5833, 42.6875, 44.1667, 50.875, 50.8958, 50.9167, 52.8125, 57.2917, 57.3125, 57.3333, 0.0}},
     {{0.05566f, -0.00717f, 0.35699f, 0.00912f, -0.00598f, 0.29549f, 0.00751f, -0.00307f, 0.1482f, -0.07141f, -0.00499f, 0.24359f, 0.00614f, -0.00314f, 0.15145f, 0.08267f}, {0.05248f, 0.00309f, -0.0084f, 0.33495f, 0.00457f, 0.1026f, 0.11833f, -0.07318f, -0.00541f, 0.26662f, 0.00676f, 0.11122f, 0.00239f, -0.12201f, -0.0023f, 0.0f}}}
};
